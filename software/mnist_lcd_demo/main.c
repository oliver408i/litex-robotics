/* On-FPGA main app (multi-page, lv_tabview).
 *
 * Tabs:
 *   - MNIST  : finger-draw a digit on the ST7796S touchscreen, tap "Classify",
 *              and the SNN-MLP inference core (gateware/snn_mlp.py) on the same
 *              ECP5 classifies it -- prediction + per-class spike bars.
 *   - Power  : CubePilot Power Brick Mini telemetry (V/A/W/mAh) via the MCP3008
 *              aux ADC (common/power.c + common/adc.c).
 *   - Logger : field status for the SD IMU logger (placeholder until the SD
 *              path lands; see icepi_zero_logger.py).
 *
 * Requires a SoC with LCD+touch+SNN AND the aux SPI bus (MCP3008/IMU): build
 * the gateware from icepi_zero_all.py.
 *
 * Fully standalone: the trained weight blob + biases are baked into the
 * firmware image (snn_assets.h, generated by tools/gen_mnist_demo_assets.py)
 * and the loader's weight_base CSR is pointed straight at the .rodata blob in
 * SDRAM. No host attached.
 *
 * Structure:
 *   - LVGL display/touch/tick glue ....... copied from software/lvgl_demo
 *   - SNN CSR driver helpers ............. copied from software/snn_mnist_demo
 *   - drawing canvas + preprocessing ..... new (the demo logic)
 */
#include <stdint.h>
#include <stdbool.h>
#include <string.h>

#include <irq.h>
#include <libbase/uart.h>
#include <system.h>            /* flush_cpu_dcache, flush_l2_cache */
#include <generated/csr.h>
#include <generated/mem.h>
#include <generated/soc.h>

#include "lvgl.h"

#include "lcd.h"
#include "touch.h"
#include "log.h"
#include "adc.h"
#include "power.h"
#include "imu_log.h"

#include "snn_assets.h"

/* LVGL's TLSF allocator uses __builtin_ffs(); RV32 without the B extension
 * needs this libgcc helper we don't ship. (Same shim as lvgl_demo.) */
int __ffssi2(int x);
int __ffssi2(int x)
{
	if(x == 0) return 0;
	int n = 1;
	if((x & 0x0000ffff) == 0) { n += 16; x >>= 16; }
	if((x & 0x000000ff) == 0) { n += 8;  x >>= 8;  }
	if((x & 0x0000000f) == 0) { n += 4;  x >>= 4;  }
	if((x & 0x00000003) == 0) { n += 2;  x >>= 2;  }
	if((x & 0x00000001) == 0) { n += 1; }
	return n;
}

uint32_t bm_get_idle_percent(void);
uint32_t bm_get_idle_percent(void) { return 0; }

/* ======================================================================== */
/*  SNN CSR driver (from software/snn_mnist_demo/main.c)                     */
/* ======================================================================== */

static inline void snn_start_pulse(void) { snn_control_write(1u); }       /* bit0 start */
static inline void snn_clear_pulse(void) { snn_control_write(2u); }       /* bit1 clear_state */

static inline void snn_pixel_commit(uint16_t addr, int16_t data)
{
	snn_pixel_addr_write(addr);
	snn_pixel_data_write((uint16_t)data);
	snn_pixel_ctl_write(1u);                                              /* .we pulse */
}
static inline void snn_bias_commit(uint16_t addr, int16_t data)
{
	snn_bias_addr_write(addr);
	snn_bias_data_write((uint16_t)data);
	snn_bias_ctl_write(1u);                                               /* .we pulse */
}
static inline int snn_done(void)           { return (snn_status_read() >> 1) & 1u; }
static inline uint8_t snn_classification(void) { return (uint8_t)((snn_status_read() >> 5) & 0xFu); }

static uint8_t spike_count_read(int i)
{
	switch(i) {
	case 0:  return (uint8_t)snn_spike_count_0_read();
	case 1:  return (uint8_t)snn_spike_count_1_read();
	case 2:  return (uint8_t)snn_spike_count_2_read();
	case 3:  return (uint8_t)snn_spike_count_3_read();
	case 4:  return (uint8_t)snn_spike_count_4_read();
	case 5:  return (uint8_t)snn_spike_count_5_read();
	case 6:  return (uint8_t)snn_spike_count_6_read();
	case 7:  return (uint8_t)snn_spike_count_7_read();
	case 8:  return (uint8_t)snn_spike_count_8_read();
	case 9:  return (uint8_t)snn_spike_count_9_read();
	default: return 0;
	}
}

/* One-time loader/bias setup. The weight blob lives in .rodata (SDRAM); point
 * the loader straight at it. The flush is mandatory: the loader's DMA reads via
 * a dedicated native SDRAM port that BYPASSES the L2, so dirty CPU writes must
 * be pushed out to physical SDRAM first (see docs/snn_mnist.md "LiteDRAM L2
 * coherence"). */
static void snn_setup(void)
{
	snn_weight_base_write((uint32_t)(uintptr_t)snn_weights_blob);
	snn_weight_preamble_beats_write(SNN_PREAMBLE_BEATS);
	snn_weight_beats_per_cycle_write(SNN_BEATS_PER_CYCLE);
	snn_weight_num_cycles_write(SNN_NUM_CYCLES);

	for(int i = 0; i < SNN_BIAS_COUNT; i++)
		snn_bias_commit((uint16_t)i, snn_biases[i]);

	flush_cpu_dcache();
#ifdef CONFIG_L2_SIZE
	flush_l2_cache();
#endif
}

/* ======================================================================== */
/*  LVGL tick source (from lvgl_demo) -- timer0 free-running countdown       */
/* ======================================================================== */

static uint32_t tick_prev_cycles;
static uint32_t tick_accum_ms;
static uint32_t tick_cycles_carry;

static uint32_t lvgl_tick_get_ms_cb(void)
{
	timer0_update_value_write(1);
	uint32_t now   = timer0_value_read();
	uint32_t delta = (tick_prev_cycles - now) + tick_cycles_carry;
	tick_prev_cycles = now;

	uint32_t cycles_per_ms = CONFIG_CLOCK_FREQUENCY / 1000u;
	tick_accum_ms     += delta / cycles_per_ms;
	tick_cycles_carry  = delta % cycles_per_ms;
	return tick_accum_ms;
}

static void lvgl_tick_init(void)
{
	timer0_en_write(0);
	timer0_load_write(0xffffffffu);
	timer0_reload_write(0xffffffffu);
	timer0_en_write(1);
	timer0_update_value_write(1);
	tick_prev_cycles  = timer0_value_read();
	tick_accum_ms     = 0;
	tick_cycles_carry = 0;
}

/* ======================================================================== */
/*  LVGL display driver (from lvgl_demo) -- async DMA flush                  */
/* ======================================================================== */

static uint16_t lvgl_fb1[LCD_WIDTH * LCD_HEIGHT] __attribute__((aligned(4)));
static uint16_t lvgl_fb2[LCD_WIDTH * LCD_HEIGHT] __attribute__((aligned(4)));

/* Synchronous flush.
 *
 * LVGL issues MULTIPLE disjoint dirty areas in a single refresh (button press
 * feedback, the result+status+bars all updating on Classify, the initial UI
 * paint). The earlier async design fired a DMA op per area and relied on the
 * op-done ISR to signal flush_ready -- but with a single in-flight pointer and
 * a one-slot op queue, completions for multiple areas got miscounted, so LVGL
 * was told "done" for an area the engine was still shifting out. It then
 * re-rendered that widget into the framebuffer (direct mode re-renders changed
 * regions every frame to keep both buffers in sync) WHILE the engine was
 * DMA-reading those pixels -> torn reads -> mis-colored line glitches.
 *
 * The drawing canvas was immune only because it's white-on-black: re-rendering
 * white over white mid-read is invisible. Colored widgets are not.
 *
 * Fix: fire the op, drain the engine, THEN signal ready. LVGL can never touch
 * a region the engine is still reading. Cost is negligible -- drawing is one
 * small rect per frame; widget/full-screen redraws are infrequent. */
static void lvgl_flush_cb(lv_display_t *disp, const lv_area_t *area, uint8_t *px_map)
{
	uint16_t x1 = (uint16_t)area->x1;
	uint16_t x2 = (uint16_t)area->x2;
	uint16_t y1 = (uint16_t)area->y1;
	uint16_t y2 = (uint16_t)area->y2;
	uint32_t w  = (uint32_t)(x2 - x1 + 1);
	uint32_t h  = (uint32_t)(y2 - y1 + 1);

	uint32_t src_off  = ((uint32_t)y1 * LCD_WIDTH + x1) * 2u;
	uint32_t row_b    = w * 2u;
	uint32_t stride_b = (uint32_t)LCD_WIDTH * 2u;

	lcd_wait_can_accept();
	lcd_rect_x_write(((uint32_t)x2 << 16) | (uint32_t)x1);
	lcd_rect_y_write(((uint32_t)y2 << 16) | (uint32_t)y1);
	lcd_dma_src_write((uint32_t)px_map + src_off);
	lcd_dma_row_bytes_write(row_b);
	lcd_dma_row_count_write(h);
	lcd_dma_stride_write(stride_b);

	lcd_op_write(LCD_OP_DMA_RECT);

	lcd_wait_idle();                 /* drain before releasing the buffer to LVGL */
	lv_display_flush_ready(disp);
}

/* ======================================================================== */
/*  LVGL touch indev (from lvgl_demo)                                        */
/* ======================================================================== */

static void lvgl_touch_read_cb(lv_indev_t *indev, lv_indev_data_t *data)
{
	(void)indev;

	uint8_t buf[7];
	if(!ft6336u_read(0x02, buf, sizeof(buf))) {
		data->state = LV_INDEV_STATE_RELEASED;
		return;
	}

	unsigned int n = buf[0] & 0x0f;
	if(n == 0) {
		data->state = LV_INDEV_STATE_RELEASED;
		return;
	}
	unsigned int x = ((buf[1] & 0x0f) << 8) | buf[2];
	unsigned int y = ((buf[3] & 0x0f) << 8) | buf[4];

	if(x >= LCD_WIDTH)  x = LCD_WIDTH  - 1;
	if(y >= LCD_HEIGHT) y = LCD_HEIGHT - 1;
	data->point.x = (lv_coord_t)x;
	data->point.y = (lv_coord_t)y;
	data->state   = LV_INDEV_STATE_PRESSED;
}

/* ======================================================================== */
/*  Drawing canvas + MNIST preprocessing                                     */
/* ======================================================================== */

#define CANVAS_DIM   280            /* square drawing area, panel-centered    */
#define BRUSH_R      9              /* brush radius in canvas px              */
#define INK_WHITE    0xFFFFu        /* RGB565 white (swap-invariant)          */
#define INK_BLACK    0x0000u

/* Grayscale source-of-truth for preprocessing (0 = bg, 255 = full ink). */
static uint8_t  ink[CANVAS_DIM * CANVAS_DIM];
/* RGB565 buffer LVGL renders from. 4-aligned per LV_DRAW_BUF_ALIGN. */
static uint16_t canvas_px[CANVAS_DIM * CANVAS_DIM] __attribute__((aligned(4)));

static lv_obj_t *canvas;
static lv_obj_t *result_label;
static lv_obj_t *lat_cpu_label;   /* CPU-side preprocessing/load time */
static lv_obj_t *lat_hw_label;    /* hardware core (loader+core) run time */
static lv_obj_t *spike_bars[SNN_OUT_SIZE];

static int draw_active;
static int last_lx, last_ly;

static inline void clampi(int *v, int lo, int hi)
{
	if(*v < lo) *v = lo;
	if(*v > hi) *v = hi;
}

/* Stamp a filled disc of ink at canvas-local (cx,cy); expand dirty bbox. */
static void stamp(int cx, int cy, int *dminx, int *dminy, int *dmaxx, int *dmaxy)
{
	for(int dy = -BRUSH_R; dy <= BRUSH_R; dy++) {
		int ly = cy + dy;
		if(ly < 0 || ly >= CANVAS_DIM) continue;
		for(int dx = -BRUSH_R; dx <= BRUSH_R; dx++) {
			if(dx * dx + dy * dy > BRUSH_R * BRUSH_R) continue;
			int lx = cx + dx;
			if(lx < 0 || lx >= CANVAS_DIM) continue;
			int idx = ly * CANVAS_DIM + lx;
			ink[idx]       = 255;
			canvas_px[idx] = INK_WHITE;
			if(lx < *dminx) *dminx = lx;
			if(lx > *dmaxx) *dmaxx = lx;
			if(ly < *dminy) *dminy = ly;
			if(ly > *dmaxy) *dmaxy = ly;
		}
	}
}

/* Stamp discs along the segment (x0,y0)->(x1,y1) and invalidate the dirty
 * rect only (whole-canvas flush per stroke would be ~14 ms over SPI). */
static void draw_segment(int x0, int y0, int x1, int y1)
{
	int dx = x1 - x0, dy = y1 - y0;
	int adx = dx < 0 ? -dx : dx;
	int ady = dy < 0 ? -dy : dy;
	int steps = adx > ady ? adx : ady;
	int n = steps / 3 + 1;                       /* a stamp every ~3 px */

	int dminx = CANVAS_DIM, dminy = CANVAS_DIM, dmaxx = -1, dmaxy = -1;
	for(int i = 0; i <= n; i++) {
		int x = x0 + dx * i / n;
		int y = y0 + dy * i / n;
		stamp(x, y, &dminx, &dminy, &dmaxx, &dmaxy);
	}
	if(dmaxx < 0) return;

	lv_area_t c;
	lv_obj_get_coords(canvas, &c);
	lv_area_t a;
	a.x1 = c.x1 + dminx;
	a.y1 = c.y1 + dminy;
	a.x2 = c.x1 + dmaxx;
	a.y2 = c.y1 + dmaxy;
	lv_obj_invalidate_area(canvas, &a);
}

static void canvas_draw_event_cb(lv_event_t *e)
{
	lv_event_code_t code = lv_event_get_code(e);
	lv_indev_t *indev = lv_indev_active();
	if(!indev) return;

	lv_point_t p;
	lv_indev_get_point(indev, &p);
	lv_area_t c;
	lv_obj_get_coords(canvas, &c);
	int lx = p.x - c.x1;
	int ly = p.y - c.y1;
	clampi(&lx, 0, CANVAS_DIM - 1);
	clampi(&ly, 0, CANVAS_DIM - 1);

	if(code == LV_EVENT_PRESSED) {
		draw_active = 1;
		last_lx = lx; last_ly = ly;
		draw_segment(lx, ly, lx, ly);
	} else if(code == LV_EVENT_PRESSING) {
		if(draw_active) draw_segment(last_lx, last_ly, lx, ly);
		else            { draw_active = 1; draw_segment(lx, ly, lx, ly); }
		last_lx = lx; last_ly = ly;
	} else if(code == LV_EVENT_RELEASED || code == LV_EVENT_PRESS_LOST) {
		draw_active = 0;
	}
}

static void canvas_clear(void)
{
	memset(ink, 0, sizeof(ink));
	for(int i = 0; i < CANVAS_DIM * CANVAS_DIM; i++) canvas_px[i] = INK_BLACK;
	lv_obj_invalidate(canvas);
}

/* Hand-drawn -> 28x28 MNIST-style tensor, then load into the SNN pixel mem.
 * Replicates the canonical MNIST test-time normalization so finger input
 * matches the training distribution:
 *   crop to ink bbox -> area-average scale longest side to 20 px (aspect
 *   preserved) -> place in 28x28 so the intensity centroid lands at center.
 * Pixel encoding matches tools/stream_snn_mnist_uart.py:
 *   pixel_q = round(gray01 * input_scale * 2^FRAC_BITS).
 * Returns 1 if a digit was loaded, 0 if the canvas is empty. */
static int preprocess_and_load(void)
{
	int minx = CANVAS_DIM, miny = CANVAS_DIM, maxx = -1, maxy = -1;
	for(int y = 0; y < CANVAS_DIM; y++) {
		for(int x = 0; x < CANVAS_DIM; x++) {
			if(ink[y * CANVAS_DIM + x]) {
				if(x < minx) minx = x;
				if(x > maxx) maxx = x;
				if(y < miny) miny = y;
				if(y > maxy) maxy = y;
			}
		}
	}
	if(maxx < 0) return 0;

	int bw = maxx - minx + 1;
	int bh = maxy - miny + 1;
	int lng = bw > bh ? bw : bh;
	int gw = (bw * 20 + lng / 2) / lng; clampi(&gw, 1, 20);
	int gh = (bh * 20 + lng / 2) / lng; clampi(&gh, 1, 20);

	/* Area-average downsample the cropped bbox into a gw x gh glyph. */
	static uint8_t glyph[20 * 20];
	for(int gy = 0; gy < gh; gy++) {
		int sy0 = miny + (gy * bh) / gh;
		int sy1 = miny + ((gy + 1) * bh) / gh;
		if(sy1 <= sy0) sy1 = sy0 + 1;
		for(int gx = 0; gx < gw; gx++) {
			int sx0 = minx + (gx * bw) / gw;
			int sx1 = minx + ((gx + 1) * bw) / gw;
			if(sx1 <= sx0) sx1 = sx0 + 1;
			int sum = 0, cnt = 0;
			for(int sy = sy0; sy < sy1 && sy < CANVAS_DIM; sy++)
				for(int sx = sx0; sx < sx1 && sx < CANVAS_DIM; sx++) {
					sum += ink[sy * CANVAS_DIM + sx];
					cnt++;
				}
			glyph[gy * 20 + gx] = cnt ? (uint8_t)(sum / cnt) : 0;
		}
	}

	/* Intensity centroid of the glyph. */
	long s = 0, sx = 0, sy = 0;
	for(int gy = 0; gy < gh; gy++)
		for(int gx = 0; gx < gw; gx++) {
			int v = glyph[gy * 20 + gx];
			s  += v;
			sx += (long)v * gx;
			sy += (long)v * gy;
		}
	if(s == 0) return 0;
	int comx = (int)(sx / s);
	int comy = (int)(sy / s);

	/* Place the glyph in 28x28 so its centroid sits at the center (14,14). */
	int ox = 14 - comx;
	int oy = 14 - comy;
	clampi(&ox, 0, 28 - gw);
	clampi(&oy, 0, 28 - gh);

	snn_clear_pulse();
	for(int i = 0; i < 28 * 28; i++) {
		int yy = i / 28, xx = i % 28;
		int gx = xx - ox, gy = yy - oy;
		int g = (gx >= 0 && gx < gw && gy >= 0 && gy < gh) ? glyph[gy * 20 + gx] : 0;
		/* pixel_q = round(g/255 * SNN_INPUT_SCALE_Q) */
		int pq = (g * SNN_INPUT_SCALE_Q + 127) / 255;
		snn_pixel_commit((uint16_t)i, (int16_t)pq);
	}
	return 1;
}

/* ======================================================================== */
/*  Latency timing                                                           */
/* ======================================================================== */

/* timer0 is the free-running countdown LVGL also reads for its tick. Latching
 * + reading its value is non-destructive (the counter keeps running), so we
 * can sample it around the inference path without disturbing the tick. */
static inline uint32_t timer_now_cycles(void)
{
	timer0_update_value_write(1);
	return timer0_value_read();
}

/* Cycle delta between an earlier and a later sample. The timer counts DOWN,
 * so earlier > later (mod 2^32); unsigned subtraction handles the wrap. */
static inline uint32_t cycles_between(uint32_t earlier, uint32_t later)
{
	return earlier - later;
}

static inline uint32_t cycles_to_us(uint32_t cycles)
{
	uint32_t cyc_per_us = CONFIG_CLOCK_FREQUENCY / 1000000u;   /* 50 @ 50 MHz */
	if(cyc_per_us == 0) cyc_per_us = 1;
	return cycles / cyc_per_us;
}

/* Render microseconds into a label as "<prefix>\n<m>.<uuu> ms". */
static void set_latency_label(lv_obj_t *label, const char *prefix, uint32_t us)
{
	lv_label_set_text_fmt(label, "%s\n%u.%03u ms", prefix,
	                      (unsigned)(us / 1000u), (unsigned)(us % 1000u));
}

/* ======================================================================== */
/*  UI                                                                       */
/* ======================================================================== */

static void show_result(int cls)
{
	lv_label_set_text_fmt(result_label, "%d", cls);
	for(int i = 0; i < SNN_OUT_SIZE; i++) {
		int v = spike_count_read(i);
		lv_bar_set_value(spike_bars[i], v, LV_ANIM_OFF);
		lv_color_t col = (i == cls) ? lv_palette_main(LV_PALETTE_GREEN)
		                            : lv_palette_main(LV_PALETTE_BLUE);
		lv_obj_set_style_bg_color(spike_bars[i], col, LV_PART_INDICATOR);
	}
}

static void classify_event_cb(lv_event_t *e)
{
	(void)e;

	/* CPU overhead: preprocessing + shoveling the 784 pixels in over CSRs. */
	uint32_t t0 = timer_now_cycles();
	int loaded = preprocess_and_load();
	uint32_t t1 = timer_now_cycles();
	if(!loaded) {
		lv_label_set_text(lat_cpu_label, "CPU\n-- ms");
		lv_label_set_text(lat_hw_label,  "core\n-- ms");
		return;
	}

	/* Hardware core run time: start pulse until done (loader streams weights
	 * from SDRAM and the core runs the LIF inference, all in gateware). */
	snn_start_pulse();
	while(!snn_done()) { /* UI frozen briefly, no busy_wait() */ }
	uint32_t t2 = timer_now_cycles();

	int cls = snn_classification();
	show_result(cls);

	set_latency_label(lat_cpu_label, "CPU", cycles_to_us(cycles_between(t0, t1)));
	set_latency_label(lat_hw_label,  "core", cycles_to_us(cycles_between(t1, t2)));
}

static void clear_event_cb(lv_event_t *e)
{
	(void)e;
	canvas_clear();
	lv_label_set_text(result_label, "?");
	lv_label_set_text(lat_cpu_label, "CPU\n-- ms");
	lv_label_set_text(lat_hw_label,  "core\n-- ms");
	for(int i = 0; i < SNN_OUT_SIZE; i++)
		lv_bar_set_value(spike_bars[i], 0, LV_ANIM_OFF);
}

/* Tab-bar height. The MNIST tab keeps its original full-screen layout, just
 * shifted up by this much: the tab's own label replaces the old on-screen
 * title, so the net vertical space is unchanged and nothing clips. */
#define TAB_BAR_H 32
#define MN_DY     TAB_BAR_H

/* ---- MNIST tab: the original draw + classify UI -------------------------- */
static void build_mnist_tab(lv_obj_t *parent)
{
	lv_obj_remove_flag(parent, LV_OBJ_FLAG_SCROLLABLE);
	lv_obj_set_style_pad_all(parent, 0, 0);
	lv_obj_set_style_bg_color(parent, lv_color_hex(0x202020), 0);

	/* Drawing canvas. */
	canvas = lv_canvas_create(parent);
	lv_canvas_set_buffer(canvas, canvas_px, CANVAS_DIM, CANVAS_DIM,
	                     LV_COLOR_FORMAT_RGB565);
	lv_obj_set_pos(canvas, (LCD_WIDTH - CANVAS_DIM) / 2, 36 - MN_DY);
	lv_obj_set_style_pad_all(canvas, 0, 0);
	lv_obj_set_style_border_width(canvas, 2, 0);
	lv_obj_set_style_border_color(canvas, lv_palette_main(LV_PALETTE_GREY), 0);
	lv_obj_add_flag(canvas, LV_OBJ_FLAG_CLICKABLE);
	lv_obj_add_event_cb(canvas, canvas_draw_event_cb, LV_EVENT_ALL, NULL);
	canvas_clear();

	/* Clear / Classify buttons. */
	lv_obj_t *clear_btn = lv_button_create(parent);
	lv_obj_set_size(clear_btn, 130, 46);
	lv_obj_set_pos(clear_btn, 16, 330 - MN_DY);
	lv_obj_add_event_cb(clear_btn, clear_event_cb, LV_EVENT_CLICKED, NULL);
	lv_obj_t *clear_lbl = lv_label_create(clear_btn);
	lv_label_set_text(clear_lbl, "Clear");
	lv_obj_center(clear_lbl);

	lv_obj_t *go_btn = lv_button_create(parent);
	lv_obj_set_size(go_btn, 130, 46);
	lv_obj_set_pos(go_btn, LCD_WIDTH - 16 - 130, 330 - MN_DY);
	lv_obj_set_style_bg_color(go_btn, lv_palette_main(LV_PALETTE_GREEN), 0);
	lv_obj_add_event_cb(go_btn, classify_event_cb, LV_EVENT_CLICKED, NULL);
	lv_obj_t *go_lbl = lv_label_create(go_btn);
	lv_label_set_text(go_lbl, "Classify");
	lv_obj_center(go_lbl);

	/* Big prediction digit, centered. */
	result_label = lv_label_create(parent);
	lv_obj_set_style_text_font(result_label, &lv_font_montserrat_48, 0);
	lv_obj_set_style_text_color(result_label, lv_color_white(), 0);
	lv_label_set_text(result_label, "?");
	lv_obj_align(result_label, LV_ALIGN_TOP_MID, 0, 384 - MN_DY);

	/* Latency readout flanking the prediction digit: CPU-side prep time on the
	 * left, hardware core run time on the right. Centered text so the value
	 * stays put as digit counts change. */
	lat_cpu_label = lv_label_create(parent);
	lv_obj_set_style_text_color(lat_cpu_label, lv_palette_main(LV_PALETTE_GREY), 0);
	lv_obj_set_style_text_align(lat_cpu_label, LV_TEXT_ALIGN_CENTER, 0);
	lv_label_set_text(lat_cpu_label, "CPU\n-- ms");
	lv_obj_align(lat_cpu_label, LV_ALIGN_TOP_LEFT, 14, 392 - MN_DY);

	lat_hw_label = lv_label_create(parent);
	lv_obj_set_style_text_color(lat_hw_label, lv_palette_main(LV_PALETTE_GREEN), 0);
	lv_obj_set_style_text_align(lat_hw_label, LV_TEXT_ALIGN_CENTER, 0);
	lv_label_set_text(lat_hw_label, "core\n-- ms");
	lv_obj_align(lat_hw_label, LV_ALIGN_TOP_RIGHT, -14, 392 - MN_DY);

	/* Per-class spike bars (range 0..T). 10 bars across the bottom. */
	const int bw = 26, gap = 4, n = SNN_OUT_SIZE;
	int total_w = n * bw + (n - 1) * gap;
	int x0 = (LCD_WIDTH - total_w) / 2;
	for(int i = 0; i < n; i++) {
		lv_obj_t *bar = lv_bar_create(parent);
		lv_obj_set_size(bar, bw, 34);
		lv_obj_set_pos(bar, x0 + i * (bw + gap), 438 - MN_DY);
		lv_bar_set_range(bar, 0, (int)SNN_NUM_CYCLES);
		lv_bar_set_value(bar, 0, LV_ANIM_OFF);
		spike_bars[i] = bar;
	}
}

/* ---- Power tab: 2S LiPo battery gauge ------------------------------------ */
/* Voltage-only state of charge -- the brick's current sense can't resolve this
 * board's sub-1-LSB (~128 mA) draw, so amps/watts/mAh are meaningless here and
 * dropped. Sampled off a 250 ms LVGL timer (battery state is slow; two MCP3008
 * reads cost only tens of microseconds). */
#define POWER_PERIOD_MS 250

static lv_obj_t *pwr_v_label;     /* big pack voltage          */
static lv_obj_t *pwr_soc_bar;     /* state-of-charge gauge bar */
static lv_obj_t *pwr_soc_label;   /* "52 %"                    */
static lv_obj_t *pwr_cell_label;  /* per-cell voltage          */
static lv_obj_t *pwr_raw_label;   /* raw ADC code (debug)      */

static void power_timer_cb(lv_timer_t *t)
{
	(void)t;
	power_reading_t r;
	power_read(&r);

	unsigned pct     = battery_soc_pct(r.bus_mV);
	unsigned cell_mV = (unsigned)(r.bus_mV / BATTERY_CELLS);

	/* Integer formatting (no soft-float). */
	lv_label_set_text_fmt(pwr_v_label, "%u.%01u V",
	                      (unsigned)(r.bus_mV / 1000u),
	                      (unsigned)((r.bus_mV % 1000u) / 100u));
	lv_label_set_text_fmt(pwr_cell_label, "%u.%02u V/cell  (2S LiPo)",
	                      cell_mV / 1000u, (cell_mV % 1000u) / 10u);
	lv_label_set_text_fmt(pwr_soc_label, "%u%%", pct);
	lv_bar_set_value(pwr_soc_bar, (int)pct, LV_ANIM_OFF);

	/* Color by charge: green > 50, amber 20-50, red < 20 (low-battery cue). */
	lv_color_t c = (pct > 50)  ? lv_palette_main(LV_PALETTE_GREEN)
	             : (pct >= 20) ? lv_palette_main(LV_PALETTE_AMBER)
	                           : lv_palette_main(LV_PALETTE_RED);
	lv_obj_set_style_bg_color(pwr_soc_bar, c, LV_PART_INDICATOR);
	lv_obj_set_style_text_color(pwr_v_label,
	                            (pct < 20) ? c : lv_color_white(), 0);

	lv_label_set_text_fmt(pwr_raw_label, "adc v=%u  (i=%u unused)",
	                      (unsigned)r.v_code, (unsigned)r.i_code);
}

static void build_power_tab(lv_obj_t *parent)
{
	lv_obj_remove_flag(parent, LV_OBJ_FLAG_SCROLLABLE);
	lv_obj_set_style_pad_all(parent, 12, 0);
	lv_obj_set_style_bg_color(parent, lv_color_hex(0x202020), 0);
	lv_obj_set_flex_flow(parent, LV_FLEX_FLOW_COLUMN);
	lv_obj_set_flex_align(parent, LV_FLEX_ALIGN_SPACE_EVENLY,
	                      LV_FLEX_ALIGN_CENTER, LV_FLEX_ALIGN_CENTER);

	lv_obj_t *cap = lv_label_create(parent);
	lv_label_set_text(cap, "BATTERY");
	lv_obj_set_style_text_color(cap, lv_palette_main(LV_PALETTE_GREY), 0);

	pwr_v_label = lv_label_create(parent);
	lv_obj_set_style_text_font(pwr_v_label, &lv_font_montserrat_48, 0);
	lv_obj_set_style_text_color(pwr_v_label, lv_color_white(), 0);
	lv_label_set_text(pwr_v_label, "--.- V");

	pwr_soc_bar = lv_bar_create(parent);
	lv_obj_set_size(pwr_soc_bar, 240, 28);
	lv_bar_set_range(pwr_soc_bar, 0, 100);
	lv_bar_set_value(pwr_soc_bar, 0, LV_ANIM_OFF);

	pwr_soc_label = lv_label_create(parent);
	lv_obj_set_style_text_font(pwr_soc_label, &lv_font_montserrat_28, 0);
	lv_obj_set_style_text_color(pwr_soc_label, lv_color_white(), 0);
	lv_label_set_text(pwr_soc_label, "-- %");

	pwr_cell_label = lv_label_create(parent);
	lv_obj_set_style_text_color(pwr_cell_label, lv_palette_main(LV_PALETTE_GREY), 0);
	lv_label_set_text(pwr_cell_label, "-.-- V/cell  (2S LiPo)");

	pwr_raw_label = lv_label_create(parent);
	lv_obj_set_style_text_color(pwr_raw_label, lv_palette_main(LV_PALETTE_GREY), 0);
	lv_label_set_text(pwr_raw_label, "adc v=--");

	lv_timer_create(power_timer_cb, POWER_PERIOD_MS, NULL);
}

/* ---- Logger tab: live IMU->SD logger status ------------------------------ */
static lv_obj_t *lgr_state_label;
static lv_obj_t *lgr_file_label;
static lv_obj_t *lgr_stat_label;

static void logger_timer_cb(lv_timer_t *t)
{
	(void)t;
	const imu_log_status_t *st = imu_log_get_status();

	const char *state_str = (st->state == IMU_LOG_RUNNING) ? "LOGGING"
	                      : (st->state == IMU_LOG_IDLE)     ? "idle"
	                                                        : "ERROR";
	lv_color_t col = (st->state == IMU_LOG_RUNNING) ? lv_palette_main(LV_PALETTE_GREEN)
	               : (st->state == IMU_LOG_ERROR)   ? lv_palette_main(LV_PALETTE_RED)
	                                                : lv_palette_main(LV_PALETTE_GREY);
	lv_label_set_text(lgr_state_label, state_str);
	lv_obj_set_style_text_color(lgr_state_label, col, 0);

	if (st->state == IMU_LOG_ERROR)
		lv_label_set_text_fmt(lgr_file_label, "err %d   imu:%s",
		                      st->last_err, st->imu_ok ? "ok" : "FAIL");
	else
		lv_label_set_text_fmt(lgr_file_label, "%s", st->filename);

	lv_label_set_text_fmt(lgr_stat_label, "samples: %u\nbytes: %u\noverruns: %u",
	                      (unsigned)st->samples, (unsigned)st->bytes,
	                      (unsigned)st->overruns);
}

static void build_logger_tab(lv_obj_t *parent)
{
	lv_obj_remove_flag(parent, LV_OBJ_FLAG_SCROLLABLE);
	lv_obj_set_style_pad_all(parent, 12, 0);
	lv_obj_set_style_bg_color(parent, lv_color_hex(0x202020), 0);
	lv_obj_set_flex_flow(parent, LV_FLEX_FLOW_COLUMN);
	lv_obj_set_flex_align(parent, LV_FLEX_ALIGN_SPACE_EVENLY,
	                      LV_FLEX_ALIGN_CENTER, LV_FLEX_ALIGN_CENTER);

	lv_obj_t *cap = lv_label_create(parent);
	lv_obj_set_style_text_color(cap, lv_palette_main(LV_PALETTE_GREY), 0);
	lv_label_set_text(cap, "IMU LOGGER");

	lgr_state_label = lv_label_create(parent);
	lv_obj_set_style_text_font(lgr_state_label, &lv_font_montserrat_28, 0);
	lv_obj_set_style_text_color(lgr_state_label, lv_palette_main(LV_PALETTE_GREY), 0);
	lv_label_set_text(lgr_state_label, "...");

	lgr_file_label = lv_label_create(parent);
	lv_obj_set_style_text_color(lgr_file_label, lv_color_white(), 0);
	lv_label_set_text(lgr_file_label, "--");

	lgr_stat_label = lv_label_create(parent);
	lv_obj_set_style_text_align(lgr_stat_label, LV_TEXT_ALIGN_CENTER, 0);
	lv_obj_set_style_text_color(lgr_stat_label, lv_palette_main(LV_PALETTE_GREY), 0);
	lv_label_set_text(lgr_stat_label, "samples: --\nbytes: --\noverruns: --");

	lv_timer_create(logger_timer_cb, 500, NULL);
}

static void build_ui(void)
{
	lv_obj_t *root = lv_screen_active();
	lv_obj_remove_flag(root, LV_OBJ_FLAG_SCROLLABLE);
	lv_obj_set_style_bg_color(root, lv_color_hex(0x202020), 0);

	lv_obj_t *tv = lv_tabview_create(root);
	lv_tabview_set_tab_bar_size(tv, TAB_BAR_H);
	lv_obj_set_style_bg_color(tv, lv_color_hex(0x202020), 0);

	build_mnist_tab (lv_tabview_add_tab(tv, "MNIST"));
	build_power_tab (lv_tabview_add_tab(tv, "Power"));
	build_logger_tab(lv_tabview_add_tab(tv, "Logger"));
}

/* ======================================================================== */
/*  main                                                                     */
/* ======================================================================== */

int main(void)
{
	uart_init();
#ifdef CONFIG_CPU_HAS_INTERRUPT
	irq_setie(1);
#endif

	log_puts("mnist_lcd_demo starting"); log_nl();
	log_puts("sys clk : "); log_uint(CONFIG_CLOCK_FREQUENCY); log_puts(" Hz"); log_nl();

	lcd_pads_apply();
	lcd_init();
	busy_wait(200);                  /* FT6336U wants ~200 ms after reset */
	touch_init();
	ft6336u_probe();

	snn_setup();
	log_puts("SNN weights @ 0x"); log_hex32((uint32_t)(uintptr_t)snn_weights_blob); log_nl();
	log_puts("LCD + touch + SNN ready"); log_nl();

	lvgl_tick_init();
	lv_init();
	lv_tick_set_cb(lvgl_tick_get_ms_cb);

	lv_display_t *disp = lv_display_create(LCD_WIDTH, LCD_HEIGHT);
	lv_display_set_color_format(disp, LV_COLOR_FORMAT_RGB565_SWAPPED);
	lv_display_set_buffers(disp, lvgl_fb1, lvgl_fb2, sizeof(lvgl_fb1),
	                       LV_DISPLAY_RENDER_MODE_DIRECT);
	lv_display_set_flush_cb(disp, lvgl_flush_cb);

	/* Flush is synchronous now (see lvgl_flush_cb); no op-done IRQ needed. */

	lv_indev_t *indev = lv_indev_create();
	lv_indev_set_type(indev, LV_INDEV_TYPE_POINTER);
	lv_indev_set_read_cb(indev, lvgl_touch_read_cb);

	build_ui();

	/* Direct render mode keeps two full framebuffers and paints only the
	 * active one per refresh, swapping between them. Both start black (.bss),
	 * so the first buffer swap would briefly show a half-painted frame. Prime
	 * BOTH by forcing two full-screen refreshes before the user sees anything. */
	for(int i = 0; i < 2; i++) {
		lv_obj_invalidate(lv_screen_active());
		lv_refr_now(disp);
	}

	/* Start logging at boot: LSM6DS3 FIFO -> SD card, stamped off the LVGL
	 * tick. Fails gracefully (Logger tab shows ERROR) if no card is present. */
	if(imu_log_start(lvgl_tick_get_ms_cb()) == 0)
		log_puts("imu_log: started");
	else
		log_puts("imu_log: start failed (no SD card / IMU?)");
	log_nl();

	log_puts("entering main loop"); log_nl();

	/* No busy_wait() past lvgl_tick_init() -- it reloads timer0. The logger
	 * drains the IMU FIFO each iteration; the hardware FIFO absorbs the jitter
	 * from LVGL's occasionally-long render frames. */
	for(;;) {
		(void)lv_timer_handler();
		imu_log_poll(lvgl_tick_get_ms_cb());
	}

	return 0;
}
